## config/Kconfig
```kconfig
# Charybdis debug instrumentation options (config/ Zephyr module).

config CHARYBDIS_HANG_CAPTURE
	bool "Charybdis watchdog hang capture + boot replay"
	depends on WATCHDOG && HWINFO
	help
	  Catch a CPU/scheduler HANG on the central half that a normal deferred
	  USB log can never deliver (a stalled CPU never drains the log buffer,
	  and a hang triggers no fault handler).

	  A low-priority heartbeat thread feeds the hardware watchdog while the
	  scheduler is healthy. A hang stops the feed; on watchdog timeout an ISR
	  records a minimal fingerprint (uptime, the interrupted thread's name,
	  best-effort stacked PC/LR) into a __noinit RAM struct, then the SoC
	  resets. The reset is warm, so RAM is retained; at the next boot the
	  captured fingerprint is logged as a HANGDUMP line over USB (the serial
	  capture script's reconnect loop stitches it into the same logfile).

	  The watchdog is set up with WDT_OPT_PAUSE_IN_SLEEP so it cannot fire
	  during legitimate deep sleep (CONFIG_ZMK_SLEEP) — it only runs while the
	  CPU is awake/spinning, which is exactly the hang we are hunting.

	  DEBUG BUILD ONLY. Default n; enabled via -DCONFIG_CHARYBDIS_HANG_CAPTURE=y
	  in the charybdis_right_debug build.yaml entry. Do not ship in the normal
	  daily-driver build without a hardware smoke test first.

config CHARYBDIS_HANG_CAPTURE_TIMEOUT_MS
	int "Watchdog timeout (ms)"
	depends on CHARYBDIS_HANG_CAPTURE
	default 20000
	help
	  Watchdog window (awake time). Must be comfortably longer than the worst
	  legitimate gap between heartbeat feeds under load, so normal operation
	  never trips it. The hang is permanent, so a large value only delays
	  detection, it does not miss the event. 20s is conservative.

config CHARYBDIS_HANG_CAPTURE_FEED_MS
	int "Heartbeat feed interval (ms)"
	depends on CHARYBDIS_HANG_CAPTURE
	default 4000
	help
	  How often the heartbeat thread feeds the watchdog. Must be well under
	  the timeout (default 4s feed vs 20s timeout = 5x margin).

config CHARYBDIS_TELEMETRY
	bool "Charybdis USB telemetry + control"
	depends on SHELL
	select THREAD_RUNTIME_STATS
	select SCHED_THREAD_USAGE
	help
	  Register a `charybdis` shell subcommand set on the USB CDC so a host TUI
	  (scripts/charybdis_dashboard.py) can poll `charybdis telem` for a
	  machine-parseable health line (uptime, both halves' battery %, right-half
	  millivolts, CPU busy%) and toggle the EXT_POWER rail
	  (`charybdis power on|off|toggle`).

	  Telemetry is printed with shell_print from the command handler, not the
	  log system: when CONFIG_SHELL owns the USB CDC there is no active log
	  backend on it, so a bare LOG_INF is dropped. The host drives the refresh
	  cadence by re-issuing `charybdis telem`.

	  Requires the zmk-usb-logging snippet (it points zephyr,shell-uart at the
	  USB CDC) plus CONFIG_SHELL=y. THREAD_RUNTIME_STATS and SCHED_THREAD_USAGE
	  are selected here so the CPU busy% is always available. No fuel gauge
	  exists on nice!nano_v2, so no current is measured — the host estimates
	  drain rate from the voltage/SoC slope.

	  DIAGNOSTIC BUILD ONLY. Default n; enabled on the charybdis_right_telem
	  build.yaml entry and the `make telem` target.
```
