## config/boards/shields/charybdis/Kconfig.defconfig
```kconfig
if SHIELD_CHARYBDIS_RIGHT

# ZMK_KEYBOARD_NAME is set in config/charybdis.conf (single source, shared by
# both halves and honoured by CI). No default here so there is one place to edit.

config ZMK_SPLIT_BLE_ROLE_CENTRAL
	default y

endif

if SHIELD_CHARYBDIS_LEFT || SHIELD_CHARYBDIS_RIGHT

config ZMK_SPLIT
	default y

endif
```
