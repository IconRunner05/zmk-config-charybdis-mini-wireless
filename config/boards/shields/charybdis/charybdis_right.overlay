/*
 * Copyright (c) 2020 ZMK Contributors
 *
 * SPDX-License-Identifier: MIT
 */
 
/* Per-side breakout map MUST come before charybdis.dtsi so the shared
 * dtsi sees MATRIX_ROW*_PIN definitions for this half. */
#include "breakout_right.dtsi"
#include "charybdis.dtsi"
#include "pmw3610.dtsi"
#include <zephyr/dt-bindings/input/input-event-codes.h>
#include <dt-bindings/zmk/input_transform.h>


&default_transform {
    col-offset = <6>;
};

&five_column_transform {
    col-offset = <5>;
};

&kscan0 {
	/* Col pins reference pad macros from breakout_right.dtsi. */
	col-gpios
		= <&pro_micro R_PAD_C1 (GPIO_ACTIVE_HIGH | GPIO_PULL_DOWN)>
		, <&pro_micro R_PAD_C2 (GPIO_ACTIVE_HIGH | GPIO_PULL_DOWN)>
		, <&pro_micro R_PAD_C3 (GPIO_ACTIVE_HIGH | GPIO_PULL_DOWN)>
		, <&pro_micro R_PAD_C4 (GPIO_ACTIVE_HIGH | GPIO_PULL_DOWN)>
		, <&pro_micro R_PAD_C5 (GPIO_ACTIVE_HIGH | GPIO_PULL_DOWN)>
		, <&pro_micro R_PAD_C6 (GPIO_ACTIVE_HIGH | GPIO_PULL_DOWN)>
		;
};
